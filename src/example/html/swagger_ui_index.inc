static const char swagger_ui_index_html[] =
"<!DOCTYPE html>\n"
"<html>\n"
"<head>\n"
"<meta charset=\"utf-8\">\n"
"<title>WebAPI Explorer</title>\n"
"\n"
"<style>\n"
"body {\n"
"    font-family: sans-serif;\n"
"    margin: 30px;\n"
"}\n"
"\n"
"h1 {\n"
"    margin-bottom: 10px;\n"
"}\n"
"\n"
".endpoint {\n"
"    border: 1px solid #ccc;\n"
"    padding: 15px;\n"
"    margin-bottom: 15px;\n"
"}\n"
"\n"
".method {\n"
"    font-weight: bold;\n"
"}\n"
"\n"
"button {\n"
"    margin-top: 8px;\n"
"}\n"
"\n"
"textarea {\n"
"    width: 100%;\n"
"    height: 80px;\n"
"}\n"
"\n"
".response {\n"
"    background: #f5f5f5;\n"
"    padding: 10px;\n"
"    margin-top: 10px;\n"
"    white-space: pre;\n"
"}\n"
"</style>\n"
"\n"
"<script src=\"swagger-ui.js\"></script>\n"
"\n"
"</head>\n"
"\n"
"<body>\n"
"\n"
"<h1>Device API</h1>\n"
"\n"
"<div id=\"endpoints\">\n"
"Loading API...\n"
"</div>\n"
"\n"
"</body>\n"
"</html>\n";