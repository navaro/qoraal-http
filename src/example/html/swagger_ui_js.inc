static const char swagger_ui_js[] =
"async function loadOpenAPI() {\n"
"    const container = document.getElementById(\"endpoints\");\n"
"\n"
"    try {\n"
"        container.innerText = \"Loading API...\";\n"
"\n"
"        const res = await fetch(\"/webapi/openapi.json\");\n"
"        if (!res.ok) {\n"
"            container.innerText = \"Failed to load /webapi/openapi.json, status \" + res.status;\n"
"            return;\n"
"        }\n"
"\n"
"        const api = await res.json();\n"
"        container.innerHTML = \"\";\n"
"\n"
"        const paths = api.paths;\n"
"        if (!paths) {\n"
"            container.innerText = \"openapi.json loaded but contains no paths\";\n"
"            return;\n"
"        }\n"
"\n"
"        for (const path in paths) {\n"
"            const methods = paths[path];\n"
"\n"
"            for (const method in methods) {\n"
"                const info = methods[method];\n"
"\n"
"                const div = document.createElement(\"div\");\n"
"                div.className = \"endpoint\";\n"
"\n"
"                const title = document.createElement(\"div\");\n"
"                title.className = \"method\";\n"
"                title.innerText = method.toUpperCase() + \" \" + path;\n"
"                div.appendChild(title);\n"
"\n"
"                if (info.summary) {\n"
"                    const summary = document.createElement(\"div\");\n"
"                    summary.innerText = info.summary;\n"
"                    div.appendChild(summary);\n"
"                }\n"
"\n"
"                let form = null;\n"
"                let postProps = null;\n"
"\n"
"                if (method === \"post\") {\n"
"                    postProps = info.requestBody && info.requestBody.content &&\n"
"                               info.requestBody.content[\"application/json\"] &&\n"
"                               info.requestBody.content[\"application/json\"].schema &&\n"
"                               info.requestBody.content[\"application/json\"].schema.properties;\n"
"\n"
"                    form = document.createElement(\"div\");\n"
"\n"
"                    if (postProps) {\n"
"                        for (const key in postProps) {\n"
"                            const prop = postProps[key];\n"
"\n"
"                            const row = document.createElement(\"div\");\n"
"                            row.style.marginTop = \"8px\";\n"
"\n"
"                            const label = document.createElement(\"label\");\n"
"                            label.innerText = key + (prop.description ? \" - \" + prop.description : \"\");\n"
"                            label.style.display = \"block\";\n"
"                            row.appendChild(label);\n"
"\n"
"                            let input;\n"
"\n"
"                            if (prop.type === \"boolean\") {\n"
"                                input = document.createElement(\"select\");\n"
"                                const optEmpty = document.createElement(\"option\");\n"
"                                optEmpty.value = \"\";\n"
"                                optEmpty.innerText = \"<not set>\";\n"
"                                input.appendChild(optEmpty);\n"
"                                const optTrue = document.createElement(\"option\");\n"
"                                optTrue.value = \"true\";\n"
"                                optTrue.innerText = \"true\";\n"
"                                input.appendChild(optTrue);\n"
"                                const optFalse = document.createElement(\"option\");\n"
"                                optFalse.value = \"false\";\n"
"                                optFalse.innerText = \"false\";\n"
"                                input.appendChild(optFalse);\n"
"                            } else if (prop.type === \"integer\") {\n"
"                                input = document.createElement(\"input\");\n"
"                                input.type = \"number\";\n"
"                            } else {\n"
"                                input = document.createElement(\"input\");\n"
"                                input.type = \"text\";\n"
"                            }\n"
"\n"
"                            input.dataset.key = key;\n"
"                            input.dataset.type = prop.type || \"string\";\n"
"                            input.style.width = \"100%\";\n"
"                            row.appendChild(input);\n"
"                            form.appendChild(row);\n"
"                        }\n"
"                    } else {\n"
"                        const txt = document.createElement(\"div\");\n"
"                        txt.innerText = \"No POST schema found\";\n"
"                        form.appendChild(txt);\n"
"                    }\n"
"\n"
"                    div.appendChild(form);\n"
"                }\n"
"\n"
"                const button = document.createElement(\"button\");\n"
"                button.innerText = \"Send\";\n"
"\n"
"                const response = document.createElement(\"div\");\n"
"                response.className = \"response\";\n"
"\n"
"                button.onclick = async () => {\n"
"                    try {\n"
"                        let options = {\n"
"                            method: method.toUpperCase()\n"
"                        };\n"
"\n"
"                        if (method === \"post\") {\n"
"                            const payload = {};\n"
"                            const inputs = form.querySelectorAll(\"input, select\");\n"
"\n"
"                            inputs.forEach((input) => {\n"
"                                const key = input.dataset.key;\n"
"                                const type = input.dataset.type;\n"
"                                const value = input.value;\n"
"\n"
"                                if (value === \"\") {\n"
"                                    return;\n"
"                                }\n"
"\n"
"                                if (type === \"boolean\") {\n"
"                                    payload[key] = (value === \"true\");\n"
"                                } else if (type === \"integer\") {\n"
"                                    payload[key] = parseInt(value, 10);\n"
"                                } else {\n"
"                                    payload[key] = value;\n"
"                                }\n"
"                            });\n"
"\n"
"                            options.headers = {\n"
"                                \"Content-Type\": \"application/json\"\n"
"                            };\n"
"                            options.body = JSON.stringify(payload);\n"
"                        }\n"
"\n"
"                        const r = await fetch(path, options);\n"
"                        const text = await r.text();\n"
"                        response.innerText = \"Status: \" + r.status + \"\\n\\n\" + text;\n"
"                    } catch (e) {\n"
"                        response.innerText = \"Request failed: \" + e;\n"
"                    }\n"
"                };\n"
"\n"
"                div.appendChild(button);\n"
"                div.appendChild(response);\n"
"                container.appendChild(div);\n"
"            }\n"
"        }\n"
"    } catch (e) {\n"
"        container.innerText = \"UI failed: \" + e;\n"
"    }\n"
"}\n"
"\n"
"window.onload = loadOpenAPI;\n";