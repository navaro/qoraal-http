static const char swagger_ui_js[] =
"function el(tag, className, text) {\n"
"    const e = document.createElement(tag);\n"
"    if (className) e.className = className;\n"
"    if (text !== undefined) e.innerText = text;\n"
"    return e;\n"
"}\n"
"\n"
"function clear(node) {\n"
"    while (node.firstChild) node.removeChild(node.firstChild);\n"
"}\n"
"\n"
"function pretty(value) {\n"
"    if (value === undefined || value === null) return \"\";\n"
"    if (typeof value === \"string\") return value;\n"
"    try {\n"
"        return JSON.stringify(value, null, 2);\n"
"    } catch (e) {\n"
"        return String(value);\n"
"    }\n"
"}\n"
"\n"
"function parseValue(type, value) {\n"
"    if (value === \"\") return undefined;\n"
"    if (type === \"boolean\") return value === \"true\";\n"
"    if (type === \"integer\") {\n"
"        const n = parseInt(value, 10);\n"
"        return isNaN(n) ? undefined : n;\n"
"    }\n"
"    return value;\n"
"}\n"
"\n"
"function setInputValue(input, type, value) {\n"
"    if (value === undefined || value === null) {\n"
"        if (input.tagName === \"INPUT\" || input.tagName === \"SELECT\") {\n"
"            input.value = \"\";\n"
"        }\n"
"        return;\n"
"    }\n"
"\n"
"    if (input.tagName === \"SELECT\") {\n"
"        input.value = value ? \"true\" : \"false\";\n"
"    } else {\n"
"        input.value = String(value);\n"
"    }\n"
"}\n"
"\n"
"function getJsonSchemaProps(op) {\n"
"    return op && op.requestBody && op.requestBody.content &&\n"
"           op.requestBody.content[\"application/json\"] &&\n"
"           op.requestBody.content[\"application/json\"].schema &&\n"
"           op.requestBody.content[\"application/json\"].schema.properties;\n"
"}\n"
"\n"
"function getResponseSchemaProps(op) {\n"
"    return op && op.responses && op.responses[\"200\"] &&\n"
"           op.responses[\"200\"].content &&\n"
"           op.responses[\"200\"].content[\"application/json\"] &&\n"
"           op.responses[\"200\"].content[\"application/json\"].schema &&\n"
"           op.responses[\"200\"].content[\"application/json\"].schema.properties;\n"
"}\n"
"\n"
"function buildFieldMap(entry) {\n"
"    const getProps = entry.get ? getResponseSchemaProps(entry.get) : null;\n"
"    const postProps = entry.post ? getJsonSchemaProps(entry.post) : null;\n"
"    const fields = {};\n"
"\n"
"    if (getProps) {\n"
"        for (const key in getProps) {\n"
"            fields[key] = {\n"
"                key: key,\n"
"                type: getProps[key].type || \"string\",\n"
"                description: getProps[key].description || \"\",\n"
"                readOnly: true\n"
"            };\n"
"        }\n"
"    }\n"
"\n"
"    if (postProps) {\n"
"        for (const key in postProps) {\n"
"            if (!fields[key]) {\n"
"                fields[key] = {\n"
"                    key: key,\n"
"                    type: postProps[key].type || \"string\",\n"
"                    description: postProps[key].description || \"\",\n"
"                    readOnly: false\n"
"                };\n"
"            } else {\n"
"                fields[key].type = postProps[key].type || fields[key].type || \"string\";\n"
"                if (!fields[key].description && postProps[key].description) {\n"
"                    fields[key].description = postProps[key].description;\n"
"                }\n"
"                fields[key].readOnly = false;\n"
"            }\n"
"        }\n"
"    }\n"
"\n"
"    return fields;\n"
"}\n"
"\n"
"function createInput(field) {\n"
"    const row = el(\"div\", \"prop-row\");\n"
"\n"
"    const label = el(\"label\", \"prop-label\");\n"
"    label.innerText = field.key + (field.description ? \" - \" + field.description : \"\");\n"
"    row.appendChild(label);\n"
"\n"
"    let input;\n"
"    const type = field.type || \"string\";\n"
"\n"
"    if (!field.readOnly && type === \"boolean\") {\n"
"        input = document.createElement(\"select\");\n"
"        input.className = \"prop-input\";\n"
"\n"
"        const optEmpty = document.createElement(\"option\");\n"
"        optEmpty.value = \"\";\n"
"        optEmpty.innerText = \"<not set>\";\n"
"        input.appendChild(optEmpty);\n"
"\n"
"        const optTrue = document.createElement(\"option\");\n"
"        optTrue.value = \"true\";\n"
"        optTrue.innerText = \"true\";\n"
"        input.appendChild(optTrue);\n"
"\n"
"        const optFalse = document.createElement(\"option\");\n"
"        optFalse.value = \"false\";\n"
"        optFalse.innerText = \"false\";\n"
"        input.appendChild(optFalse);\n"
"    } else {\n"
"        input = document.createElement(\"input\");\n"
"        input.type = (type === \"integer\") ? \"number\" : \"text\";\n"
"        input.className = field.readOnly ? \"prop-input prop-input-readonly\" : \"prop-input\";\n"
"        if (field.readOnly) {\n"
"            input.readOnly = true;\n"
"        }\n"
"    }\n"
"\n"
"    input.dataset.key = field.key;\n"
"    input.dataset.type = type;\n"
"    input.dataset.readonly = field.readOnly ? \"true\" : \"false\";\n"
"    row.appendChild(input);\n"
"\n"
"    if (field.readOnly) {\n"
"        row.appendChild(el(\"div\", \"prop-meta\", \"read-only\"));\n"
"    }\n"
"\n"
"    return row;\n"
"}\n"
"\n"
"async function requestJson(path, options) {\n"
"    const res = await fetch(path, options || {});\n"
"    const text = await res.text();\n"
"    let data = null;\n"
"\n"
"    try {\n"
"        data = text ? JSON.parse(text) : null;\n"
"    } catch (e) {\n"
"        data = text;\n"
"    }\n"
"\n"
"    return { res, text, data };\n"
"}\n"
"\n"
"function setResponse(responseEl, status, body, ok) {\n"
"    responseEl.className = ok ? \"response ok\" : \"response error\";\n"
"    responseEl.innerText = \"Status: \" + status + \"\\n\\n\" + body;\n"
"}\n"
"\n"
"function collectPaths(api) {\n"
"    const grouped = [];\n"
"    const paths = api.paths || {};\n"
"\n"
"    for (const path in paths) {\n"
"        grouped.push({\n"
"            path: path,\n"
"            get: paths[path].get || null,\n"
"            post: paths[path].post || null\n"
"        });\n"
"    }\n"
"\n"
"    return grouped;\n"
"}\n"
"\n"
"function isSSEEndpoint(entry) {\n"
"    return !!(entry.get &&\n"
"              entry.get.responses &&\n"
"              entry.get.responses[\"200\"] &&\n"
"              entry.get.responses[\"200\"].content &&\n"
"              entry.get.responses[\"200\"].content[\"text/event-stream\"]);\n"
"}\n"
"\n"
"function createSSECard(entry) {\n"
"    var card = el(\"div\", \"endpoint-card\");\n"
"    var header = el(\"div\", \"endpoint-header\");\n"
"    header.appendChild(el(\"div\", \"endpoint-title\", entry.path));\n"
"    header.appendChild(el(\"div\", \"endpoint-methods\", \"GET\"));\n"
"    card.appendChild(header);\n"
"    var summaryText = (entry.get && entry.get.summary) || \"\";\n"
"    if (summaryText) { card.appendChild(el(\"div\", \"endpoint-summary\", summaryText)); }\n"
"    var actions = el(\"div\", \"endpoint-actions\");\n"
"    var btnSubscribe = el(\"button\", \"btn btn-primary\", \"Subscribe\");\n"
"    var btnStop = el(\"button\", \"btn btn-secondary\", \"Stop\");\n"
"    btnStop.disabled = true;\n"
"    actions.appendChild(btnSubscribe);\n"
"    actions.appendChild(btnStop);\n"
"    card.appendChild(actions);\n"
"    var params = (entry.get && entry.get.parameters) || [];\n"
"    var paramInputs = {};\n"
"    if (params.length) {\n"
"        var form = el(\"div\", \"form\");\n"
"        params.forEach(function(p) {\n"
"            var row = el(\"div\", \"prop-row\");\n"
"            var label = el(\"label\", \"prop-label\");\n"
"            label.innerText = p.name + (p.description ? \" - \" + p.description : \"\");\n"
"            row.appendChild(label);\n"
"            var input = document.createElement(\"input\");\n"
"            input.type = \"text\";\n"
"            input.className = \"prop-input\";\n"
"            input.dataset.key = p.name;\n"
"            if (p.schema && p.schema.enum && p.schema.enum.length) {\n"
"                input.placeholder = p.schema.enum.join(\", \");\n"
"            }\n"
"            row.appendChild(input);\n"
"            paramInputs[p.name] = input;\n"
"            form.appendChild(row);\n"
"        });\n"
"        card.appendChild(form);\n"
"    }\n"
"    var logEl = el(\"pre\", \"response\", \"\");\n"
"    card.appendChild(logEl);\n"
"    var es = null;\n"
"    var eventCount = 0;\n"
"    function startSSE() {\n"
"        if (es) { es.close(); es = null; }\n"
"        var url = entry.path;\n"
"        var parts = [];\n"
"        for (var key in paramInputs) {\n"
"            var val = paramInputs[key].value.trim();\n"
"            if (val) parts.push(encodeURIComponent(key) + \"=\" + encodeURIComponent(val));\n"
"        }\n"
"        if (parts.length) url += \"?\" + parts.join(\"&\");\n"
"        eventCount = 0;\n"
"        logEl.className = \"response ok\";\n"
"        logEl.innerText = \"Connecting...\\n\";\n"
"        btnSubscribe.disabled = true;\n"
"        btnStop.disabled = false;\n"
"        es = new EventSource(url);\n"
"        es.onopen = function() {\n"
"            logEl.innerText = \"Connected. Waiting for events...\\n\";\n"
"        };\n"
"        es.onmessage = function(e) {\n"
"            eventCount++;\n"
"            var display;\n"
"            try { display = JSON.stringify(JSON.parse(e.data), null, 2); }\n"
"            catch (_) { display = e.data; }\n"
"            logEl.innerText += \"--- event \" + eventCount + \" ---\\n\" + display + \"\\n\";\n"
"            logEl.scrollTop = logEl.scrollHeight;\n"
"        };\n"
"        es.onerror = function() {\n"
"            logEl.className = \"response error\";\n"
"            logEl.innerText += \"\\nConnection error.\\n\";\n"
"            btnSubscribe.disabled = false;\n"
"            btnStop.disabled = true;\n"
"            es = null;\n"
"        };\n"
"    }\n"
"    function stopSSE() {\n"
"        if (es) { es.close(); es = null; }\n"
"        logEl.innerText += \"\\nDisconnected.\\n\";\n"
"        btnSubscribe.disabled = false;\n"
"        btnStop.disabled = true;\n"
"    }\n"
"    btnSubscribe.onclick = startSSE;\n"
"    btnStop.onclick = stopSSE;\n"
"    return card;\n"
"}\n"
"\n"
"function createEndpointCard(entry) {\n"
"    if (isSSEEndpoint(entry)) { return createSSECard(entry); }\n"
"    const card = el(\"div\", \"endpoint-card\");\n"
"\n"
"    const header = el(\"div\", \"endpoint-header\");\n"
"    const title = el(\"div\", \"endpoint-title\", entry.path);\n"
"    header.appendChild(title);\n"
"\n"
"    const methods = [];\n"
"    if (entry.get) methods.push(\"GET\");\n"
"    if (entry.post) methods.push(\"POST\");\n"
"    header.appendChild(el(\"div\", \"endpoint-methods\", methods.join(\" / \")));\n"
"    card.appendChild(header);\n"
"\n"
"    const summaryText = (entry.get && entry.get.summary) || (entry.post && entry.post.summary) || \"\";\n"
"    if (summaryText) {\n"
"        card.appendChild(el(\"div\", \"endpoint-summary\", summaryText));\n"
"    }\n"
"\n"
"    const actions = el(\"div\", \"endpoint-actions\");\n"
"    const btnReload = el(\"button\", \"btn btn-secondary\", \"Reload\");\n"
"    const btnSave = el(\"button\", \"btn btn-primary\", \"Save\");\n"
"    actions.appendChild(btnReload);\n"
"    actions.appendChild(btnSave);\n"
"    card.appendChild(actions);\n"
"\n"
"    const form = el(\"div\", \"form\");\n"
"    card.appendChild(form);\n"
"\n"
"    const response = el(\"pre\", \"response\", \"\");\n"
"    card.appendChild(response);\n"
"\n"
"    const fields = buildFieldMap(entry);\n"
"    const inputsByKey = {};\n"
"    let hasWritable = false;\n"
"\n"
"    for (const key in fields) {\n"
"        const row = createInput(fields[key]);\n"
"        const input = row.querySelector(\"input, select\");\n"
"        inputsByKey[key] = input;\n"
"        form.appendChild(row);\n"
"        if (!fields[key].readOnly) {\n"
"            hasWritable = true;\n"
"        }\n"
"    }\n"
"\n"
"    if (!Object.keys(fields).length) {\n"
"        form.appendChild(el(\"div\", \"empty\", \"No schema found\"));\n"
"    }\n"
"\n"
"    if (!hasWritable) {\n"
"        btnSave.disabled = true;\n"
"    }\n"
"\n"
"    async function reloadValues() {\n"
"        if (!entry.get) {\n"
"            setResponse(response, 0, \"GET not available for this endpoint\", false);\n"
"            return;\n"
"        }\n"
"\n"
"        btnReload.disabled = true;\n"
"        btnSave.disabled = true;\n"
"        setResponse(response, \"...\", \"Loading...\", true);\n"
"\n"
"        try {\n"
"            const result = await requestJson(entry.path, { method: \"GET\" });\n"
"            const res = result.res;\n"
"            const data = result.data;\n"
"            const text = result.text;\n"
"\n"
"            if (res.ok && data && typeof data === \"object\") {\n"
"                for (const key in inputsByKey) {\n"
"                    const input = inputsByKey[key];\n"
"                    setInputValue(input, input.dataset.type, data[key]);\n"
"                }\n"
"            }\n"
"\n"
"            setResponse(response, res.status, pretty(data !== null ? data : text), res.ok);\n"
"        } catch (e) {\n"
"            setResponse(response, \"ERR\", \"Request failed: \" + e, false);\n"
"        } finally {\n"
"            btnReload.disabled = false;\n"
"            btnSave.disabled = !hasWritable;\n"
"        }\n"
"    }\n"
"\n"
"    async function saveValues() {\n"
"        if (!entry.post || !hasWritable) {\n"
"            setResponse(response, 0, \"POST not available for this endpoint\", false);\n"
"            return;\n"
"        }\n"
"\n"
"        const payload = {};\n"
"        for (const key in inputsByKey) {\n"
"            const input = inputsByKey[key];\n"
"            if (input.dataset.readonly === \"true\") {\n"
"                continue;\n"
"            }\n"
"            const value = parseValue(input.dataset.type, input.value);\n"
"            if (value !== undefined) {\n"
"                payload[key] = value;\n"
"            }\n"
"        }\n"
"\n"
"        btnReload.disabled = true;\n"
"        btnSave.disabled = true;\n"
"        setResponse(response, \"...\", \"Sending...\", true);\n"
"\n"
"        try {\n"
"            const result = await requestJson(entry.path, {\n"
"                method: \"POST\",\n"
"                headers: { \"Content-Type\": \"application/json\" },\n"
"                body: JSON.stringify(payload)\n"
"            });\n"
"\n"
"            const res = result.res;\n"
"            const data = result.data;\n"
"            const text = result.text;\n"
"\n"
"            setResponse(response, res.status, pretty(data !== null ? data : text), res.ok);\n"
"\n"
"            if (res.ok && entry.get) {\n"
"                await reloadValues();\n"
"            }\n"
"        } catch (e) {\n"
"            setResponse(response, \"ERR\", \"Request failed: \" + e, false);\n"
"        } finally {\n"
"            btnReload.disabled = false;\n"
"            btnSave.disabled = !hasWritable;\n"
"        }\n"
"    }\n"
"\n"
"    btnReload.onclick = reloadValues;\n"
"    btnSave.onclick = saveValues;\n"
"\n"
"    if (entry.get) {\n"
"        reloadValues();\n"
"    }\n"
"\n"
"    return card;\n"
"}\n"
"\n"
"async function loadOpenAPI() {\n"
"    const container = document.getElementById(\"endpoints\");\n"
"    clear(container);\n"
"    container.appendChild(el(\"div\", \"loading\", \"Loading API...\"));\n"
"\n"
"    try {\n"
"        const res = await fetch(\"../openapi.json\");\n"
"        if (!res.ok) {\n"
"            clear(container);\n"
"            container.appendChild(el(\"div\", \"error\", \"Failed to load openapi.json, status \" + res.status));\n"
"            return;\n"
"        }\n"
"\n"
"        const api = await res.json();\n"
"        const entries = collectPaths(api);\n"
"\n"
"        clear(container);\n"
"\n"
"        if (!entries.length) {\n"
"            container.appendChild(el(\"div\", \"empty\", \"openapi.json loaded but contains no paths\"));\n"
"            return;\n"
"        }\n"
"\n"
"        entries.forEach(function(entry) {\n"
"            container.appendChild(createEndpointCard(entry));\n"
"        });\n"
"    } catch (e) {\n"
"        clear(container);\n"
"        container.appendChild(el(\"div\", \"error\", \"UI failed: \" + e));\n"
"    }\n"
"}\n"
"\n"
"window.onload = loadOpenAPI;\n";