static const char swagger_ui_index_html[] =
"<!DOCTYPE html>\n"
"<html>\n"
"<head>\n"
"<meta charset=\"utf-8\">\n"
"<meta name=\"viewport\" content=\"width=device-width, initial-scale=1\">\n"
"<title>WebAPI Explorer</title>\n"
"\n"
"<style>\n"
"body {\n"
"    margin: 0;\n"
"    padding: 24px;\n"
"    font-family: Arial, sans-serif;\n"
"    background: #0f172a;\n"
"    color: #e2e8f0;\n"
"}\n"
"\n"
"h1 {\n"
"    margin: 0 0 8px 0;\n"
"    font-size: 28px;\n"
"    color: #f8fafc;\n"
"}\n"
"\n"
".subtitle {\n"
"    margin-bottom: 24px;\n"
"    color: #94a3b8;\n"
"    font-size: 14px;\n"
"}\n"
"\n"
"#endpoints {\n"
"    display: grid;\n"
"    gap: 20px;\n"
"}\n"
"\n"
".endpoint-card {\n"
"    background: #111827;\n"
"    border: 1px solid #334155;\n"
"    border-radius: 14px;\n"
"    padding: 18px;\n"
"    box-shadow: 0 8px 24px rgba(0,0,0,0.25);\n"
"}\n"
"\n"
".endpoint-header {\n"
"    display: flex;\n"
"    justify-content: space-between;\n"
"    align-items: center;\n"
"    gap: 12px;\n"
"    margin-bottom: 8px;\n"
"    flex-wrap: wrap;\n"
"}\n"
"\n"
".endpoint-title {\n"
"    font-size: 20px;\n"
"    font-weight: bold;\n"
"    color: #f8fafc;\n"
"    word-break: break-all;\n"
"}\n"
"\n"
".endpoint-methods {\n"
"    font-size: 12px;\n"
"    font-weight: bold;\n"
"    color: #93c5fd;\n"
"    background: #1e3a8a;\n"
"    padding: 6px 10px;\n"
"    border-radius: 999px;\n"
"}\n"
"\n"
".endpoint-summary {\n"
"    color: #cbd5e1;\n"
"    margin-bottom: 16px;\n"
"}\n"
"\n"
".endpoint-actions {\n"
"    display: flex;\n"
"    gap: 10px;\n"
"    margin-bottom: 16px;\n"
"    flex-wrap: wrap;\n"
"}\n"
"\n"
".btn {\n"
"    border: 0;\n"
"    border-radius: 10px;\n"
"    padding: 10px 16px;\n"
"    font-weight: bold;\n"
"    cursor: pointer;\n"
"}\n"
"\n"
".btn:disabled {\n"
"    opacity: 0.6;\n"
"    cursor: default;\n"
"}\n"
"\n"
".btn-primary {\n"
"    background: #2563eb;\n"
"    color: white;\n"
"}\n"
"\n"
".btn-secondary {\n"
"    background: #334155;\n"
"    color: white;\n"
"}\n"
"\n"
".form {\n"
"    display: grid;\n"
"    gap: 12px;\n"
"    margin-bottom: 16px;\n"
"}\n"
"\n"
".prop-row {\n"
"    display: grid;\n"
"    gap: 6px;\n"
"}\n"
"\n"
".prop-label {\n"
"    font-size: 14px;\n"
"    color: #cbd5e1;\n"
"}\n"
"\n"
".prop-input {\n"
"    width: 100%;\n"
"    box-sizing: border-box;\n"
"    padding: 10px 12px;\n"
"    border-radius: 10px;\n"
"    border: 1px solid #475569;\n"
"    background: #0f172a;\n"
"    color: #f8fafc;\n"
"    font-size: 14px;\n"
"}\n"
"\n"
".prop-input:focus {\n"
"    outline: none;\n"
"    border-color: #60a5fa;\n"
"    box-shadow: 0 0 0 3px rgba(96, 165, 250, 0.15);\n"
"}\n"
".prop-input-readonly {\n"
"    background: #1e293b;\n"
"    color: #94a3b8;\n"
"}\n"
"\n"
".prop-meta {\n"
"    font-size: 12px;\n"
"    color: #94a3b8;\n"
"}\n"
"\n"
".response {\n"
"    margin: 0;\n"
"    padding: 14px;\n"
"    border-radius: 10px;\n"
"    white-space: pre-wrap;\n"
"    overflow-x: auto;\n"
"    font-family: monospace;\n"
"    font-size: 13px;\n"
"    line-height: 1.45;\n"
"    background: #020617;\n"
"    border: 1px solid #334155;\n"
"    min-height: 52px;\n"
"}\n"
"\n"
".response.ok {\n"
"    border-color: #166534;\n"
"}\n"
"\n"
".response.error {\n"
"    border-color: #991b1b;\n"
"}\n"
"\n"
".loading, .error, .empty {\n"
"    padding: 18px;\n"
"    border-radius: 12px;\n"
"    background: #111827;\n"
"    border: 1px solid #334155;\n"
"}\n"
"\n"
".error {\n"
"    border-color: #991b1b;\n"
"}\n"
"</style>\n"
"\n"
"<script src=\"swagger-ui.js\"></script>\n"
"\n"
"</head>\n"
"\n"
"<body>\n"
"\n"
"<h1>Device API</h1>\n"
"<div class=\"subtitle\">Interactive WebAPI explorer</div>\n"
"\n"
"<div id=\"endpoints\">\n"
"Loading API...\n"
"</div>\n"
"\n"
"</body>\n"
"</html>\n";