static const char rapidoc_index_html[] =
"<!DOCTYPE html>\n"
"<html>\n"
"<head>\n"
"  <meta charset=\"utf-8\">\n"
"  <meta name=\"viewport\" content=\"width=device-width, initial-scale=1\">\n"
"  <title>Device Control API</title>\n"
"  <script type=\"module\" src=\"https://unpkg.com/rapidoc/dist/rapidoc-min.js\"></script>\n"
"  <style>\n"
"    html, body {\n"
"      margin: 0;\n"
"      padding: 0;\n"
"      height: 100%;\n"
"      background: #0b1020;\n"
"      font-family: Arial, sans-serif;\n"
"    }\n"
"\n"
"    rapi-doc {\n"
"      height: 100vh;\n"
"      width: 100%;\n"
"    }\n"
"  </style>\n"
"</head>\n"
"<body>\n"
"  <rapi-doc\n"
"    spec-url=\"/api/v1/openapi.json\"\n"
"    theme=\"dark\"\n"
"    render-style=\"read\"\n"
"    show-header=\"true\"\n"
"    allow-spec-url-load=\"false\"\n"
"    allow-spec-file-load=\"false\"\n"
"    allow-server-selection=\"false\"\n"
"    allow-authentication=\"false\"\n"
"    schema-style=\"table\"\n"
"    primary-color=\"#7c3aed\"\n"
"    header-color=\"#111827\"\n"
"    nav-bg-color=\"#0f172a\"\n"
"    text-color=\"#e5e7eb\"\n"
"    regular-font=\"Arial, sans-serif\"\n"
"  >\n"
"    <div slot=\"nav-logo\" style=\"color:white;font-weight:bold;font-size:18px;\">\n"
"      Device Control\n"
"    </div>\n"
"  </rapi-doc>\n"
"</body>\n"
"</html>\n";