static const char dashboard_index_html[] =
"<!DOCTYPE html>\n"
"<html lang=\"en\">\n"
"<head>\n"
"<meta charset=\"utf-8\">\n"
"<meta name=\"viewport\" content=\"width=device-width, initial-scale=1\">\n"
"<title>Device Dashboard</title>\n"
"<style>\n"
"*,*::before,*::after{box-sizing:border-box;margin:0;padding:0}\n"
":root{\n"
"  --bg:#f3efe3;--card:#fffdf9;--panel:#f4ead3;--border:#e4d4b8;\n"
"  --text:#211f1b;--muted:#856f4f;--accent:#456f9f;\n"
"  --green:#35c95c;--red:#b94b43;--yellow:#c49a3f;--line:#efe4d2;\n"
"  --shadow:0 18px 46px #4b3a1a14;\n"
"}\n"
"body{background:radial-gradient(circle at top left,#fffdf7 0,#f3efe3 34%,#efe7d4 100%);\n"
"  color:var(--text);font-family:Arial,sans-serif;min-height:100vh;padding:26px}\n"
"header{\n"
"  background:linear-gradient(90deg,#fffdf8 0%,#f2e6c7 100%);\n"
"  border:1px solid var(--border);border-radius:20px;box-shadow:var(--shadow);\n"
"  padding:18px 28px;display:flex;align-items:center;justify-content:space-between;\n"
"  max-width:1280px;margin:0 auto 16px;\n"
"}\n"
"header h1{font-size:28px;font-weight:500;letter-spacing:0;color:#111}\n"
".live{display:flex;align-items:center;gap:8px;font-size:13px;color:var(--muted)}\n"
".dot{width:10px;height:10px;border-radius:50%;background:var(--yellow);transition:background .4s}\n"
".dot.ok{background:var(--green);box-shadow:0 0 8px #35c95caa;animation:glow 2.5s infinite}\n"
"@keyframes glow{0%,100%{opacity:1}50%{opacity:.5}}\n"
"main{max-width:1280px;margin:0 auto}\n"
".tabs{display:flex;gap:6px;border-bottom:1px solid var(--border);margin:4px 0 18px}\n"
".tab-btn{background:transparent;border:1px solid transparent;border-bottom:none;border-radius:6px 6px 0 0;\n"
"  color:var(--muted);cursor:pointer;font-size:12px;font-weight:700;padding:9px 14px}\n"
".tab-btn.on{background:var(--card);border-color:var(--border);color:var(--text)}\n"
".tab-panel{display:none}\n"
".tab-panel.on{display:block}\n"
".sec{font-size:11px;font-weight:700;color:var(--muted);text-transform:uppercase;\n"
"  letter-spacing:1.2px;margin:18px 0 14px}\n"
".grid{display:grid;grid-template-columns:repeat(3,1fr);\n"
"  gap:18px;margin-bottom:32px}\n"
".card{\n"
"  background:var(--card);border:1px solid var(--border);border-radius:14px;\n"
"  padding:20px;box-shadow:var(--shadow);transition:border-color .3s,box-shadow .3s;\n"
"}\n"
".card.updated{border-color:var(--green);box-shadow:0 18px 46px #35c95c1f}\n"
".card-head{display:flex;justify-content:space-between;align-items:center;margin-bottom:16px}\n"
".card-name{font-weight:700;font-size:16px;text-transform:capitalize;color:#1c1a17}\n"
".badge{font-size:11px;padding:3px 9px;border-radius:99px;font-weight:600}\n"
".badge-ok{background:#35c95c1f;color:#18833b;border:1px solid #35c95c73}\n"
".badge-load{background:#f0dfb8;color:#8b6a21;border:1px solid #cfb06e}\n"
".badge-err{background:#f6ddd8;color:var(--red);border:1px solid #d59a92}\n"
".props{display:flex;flex-direction:column}\n"
".prop{display:flex;justify-content:space-between;align-items:baseline;\n"
"  padding:7px 0;border-bottom:1px solid var(--line);font-size:13px}\n"
".prop:last-child{border-bottom:none;padding-bottom:0}\n"
".pk{color:var(--muted)}\n"
".pv{font-weight:600;text-align:right;word-break:break-all;max-width:60%}\n"
".pv-t{color:var(--green)}.pv-f{color:var(--red)}.pv-n{color:var(--muted)}\n"
".feed-wrap{background:var(--card);border:1px solid var(--border);border-radius:16px;overflow:hidden;box-shadow:var(--shadow)}\n"
".feed-head{\n"
"  padding:16px 20px;border-bottom:1px solid var(--border);\n"
"  background:linear-gradient(90deg,#fffdf8 0%,#f2e8d1 100%);\n"
"  display:flex;justify-content:space-between;align-items:center;\n"
"}\n"
".feed-title{font-weight:700;font-size:14px}\n"
".feed-meta{font-size:12px;color:var(--muted)}\n"
".feed-list{max-height:360px;overflow-y:auto}\n"
".ev{\n"
"  display:grid;grid-template-columns:68px 90px 1fr;\n"
"  gap:10px;padding:10px 20px;border-bottom:1px solid var(--line);\n"
"  font-size:13px;align-items:start;\n"
"}\n"
".ev:last-child{border-bottom:none}\n"
".ev-time{color:var(--muted);font-variant-numeric:tabular-nums;font-size:12px;padding-top:1px}\n"
".ev-src{font-weight:600;text-transform:capitalize;font-size:12px;\n"
"  padding-top:1px;overflow:hidden;text-overflow:ellipsis;white-space:nowrap}\n"
".ev-body{}\n"
".ev-kv{display:flex;flex-wrap:wrap;gap:8px}\n"
".ev-pair{\n"
"  display:inline-flex;gap:4px;background:#fbf5e9;\n"
"  border:1px solid var(--border);border-radius:6px;padding:1px 7px;font-size:12px;\n"
"}\n"
".ev-key{color:var(--muted)}.ev-val{color:var(--text);font-weight:500}\n"
".empty-feed{padding:20px;color:var(--muted);font-size:13px;text-align:center}\n"
".card-empty{color:var(--muted);font-size:13px}\n"
".pv.editable{cursor:pointer;text-decoration:underline dashed var(--border)}\n"
".pv.editable:hover{color:var(--accent)}\n"
".prop-input{background:#fffaf2;border:1px solid var(--accent);border-radius:5px;\n"
"  color:var(--text);font-size:13px;padding:2px 7px;text-align:right;width:120px;outline:none}\n"
".prop-select{background:#fffaf2;border:1px solid var(--accent);border-radius:5px;\n"
"  color:var(--text);font-size:13px;padding:2px 7px;text-align:right;max-width:140px;outline:none;cursor:pointer}\n"
".actions{display:flex;flex-wrap:wrap;gap:8px;margin-top:14px;padding-top:14px;border-top:1px solid var(--border)}\n"
".action-btn{background:var(--accent);border:1px solid #3d628f;border-radius:5px;\n"
"  color:#fff;cursor:pointer;font-size:12px;font-weight:700;padding:7px 12px;transition:all .2s}\n"
".action-btn:hover{background:#345c88;color:#fff}\n"
".action-btn:disabled{cursor:wait;opacity:.65}\n"
".action-btn.ok{border-color:var(--green);color:#fff;background:#209947}\n"
".action-btn.err{border-color:var(--red);color:#fff;background:var(--red)}\n"
".ev-filter{display:flex;flex-wrap:wrap;gap:6px;padding:10px 20px;border-bottom:1px solid var(--border)}\n"
".replay-controls{display:flex;flex-wrap:wrap;gap:8px;align-items:center;padding:10px 20px;border-bottom:1px solid var(--border)}\n"
".limit-input{background:#fffaf2;border:1px solid var(--border);border-radius:5px;color:var(--text);\n"
"  font-size:12px;padding:6px 8px;width:72px;outline:none}\n"
".chip{display:inline-flex;align-items:center;padding:3px 10px;border-radius:99px;font-size:11px;\n"
"  font-weight:600;cursor:pointer;border:1px solid var(--border);background:#fbf5e9;\n"
"  color:var(--muted);transition:all .2s;user-select:none}\n"
".chip.on{background:#e8d8b7;border-color:#d6bf87;color:#362b18}\n"
".chip-all.on{background:#35c95c1f;border-color:var(--green);color:#18833b}\n"
"</style>\n"
"</head>\n"
"<body>\n"
"<header>\n"
"  <h1>Device Dashboard</h1>\n"
"  <div class=\"live\">\n"
"    <div class=\"dot\" id=\"dot\"></div>\n"
"    <span id=\"liveLabel\">Connecting</span>\n"
"  </div>\n"
"</header>\n"
"<main>\n"
"  <div class=\"tabs\" role=\"tablist\">\n"
"    <button type=\"button\" class=\"tab-btn on\" data-tab=\"modules\" role=\"tab\" aria-selected=\"true\" aria-controls=\"tab-modules\">Modules</button>\n"
"    <button type=\"button\" class=\"tab-btn\" data-tab=\"live\" role=\"tab\" aria-selected=\"false\" aria-controls=\"tab-live\">Live Events</button>\n"
"    <button type=\"button\" class=\"tab-btn\" data-tab=\"replay\" role=\"tab\" aria-selected=\"false\" aria-controls=\"tab-replay\">Replay Events</button>\n"
"  </div>\n"
"  <section class=\"tab-panel on\" id=\"tab-modules\" role=\"tabpanel\">\n"
"    <p class=\"sec\">Modules</p>\n"
"    <div class=\"grid\" id=\"grid\"></div>\n"
"  </section>\n"
"  <section class=\"tab-panel\" id=\"tab-live\" role=\"tabpanel\">\n"
"    <p class=\"sec\">Live Events</p>\n"
"    <div class=\"feed-wrap\">\n"
"      <div class=\"feed-head\">\n"
"        <span class=\"feed-title\">Event Stream</span>\n"
"        <span class=\"feed-meta\" id=\"emeta\">waiting...</span>\n"
"      </div>\n"
"      <div class=\"ev-filter\" id=\"efilter\"></div>\n"
"      <div class=\"feed-list\" id=\"elist\">\n"
"        <div class=\"empty-feed\">Connecting to event stream...</div>\n"
"      </div>\n"
"    </div>\n"
"  </section>\n"
"  <section class=\"tab-panel\" id=\"tab-replay\" role=\"tabpanel\">\n"
"    <p class=\"sec\">Replay Events</p>\n"
"    <div class=\"feed-wrap\">\n"
"      <div class=\"feed-head\">\n"
"        <span class=\"feed-title\">Replay Query</span>\n"
"        <span class=\"feed-meta\" id=\"rmeta\">idle</span>\n"
"      </div>\n"
"      <div class=\"ev-filter\" id=\"rfilter\"></div>\n"
"      <div class=\"ev-filter\" id=\"rseverity\"></div>\n"
"      <div class=\"replay-controls\">\n"
"        <input class=\"limit-input\" id=\"rlimit\" type=\"number\" min=\"0\" max=\"100\" value=\"20\">\n"
"        <button type=\"button\" class=\"action-btn\" id=\"rsubmit\">Replay</button>\n"
"      </div>\n"
"      <div class=\"feed-list\" id=\"rlist\">\n"
"        <div class=\"empty-feed\">Replay results will appear here.</div>\n"
"      </div>\n"
"    </div>\n"
"  </section>\n"
"</main>\n"
"<script>\n"
"var SKIP={events:1,'openapi.json':1,openapi:1,dashboard:1,\n"
"  'thing-description':1,wot:1};\n"
"var cards={};\n"
"var modNames={};\n"
"var modLabels={};\n"
"var evCount=0;\n"
"var replayCount=0;\n"
"var writableProps={};\n"
"var filter={};\n"
"var replayFilter={};\n"
"var replaySeverityFilter={};\n"
"var severityNames=['debug','info','warn','error'];\n"
"var allModNames=[];\n"
"var allModEndpoints=[];\n"
"var enums={};\n"
"var actions={};\n"
"var eventSource=null;\n"
"var requestQueue=[];\n"
"var requestBusy=false;\n"
"var queuedCards={};\n"
"var refreshTimers={};\n"
"var CARD_REFRESH_DEBOUNCE_MS=150;\n"
"var apiRoot=apiRootFromLocation();\n"
"\n"
"function ts(sec){\n"
"  var d=sec?new Date(sec*1000):new Date();\n"
"  return ('0'+d.getHours()).slice(-2)+':'+\n"
"         ('0'+d.getMinutes()).slice(-2)+':'+\n"
"         ('0'+d.getSeconds()).slice(-2);\n"
"}\n"
"\n"
"function epName(path){ return path.split('/').pop(); }\n"
"\n"
"function showTab(name){\n"
"  document.querySelectorAll('.tab-btn').forEach(function(b){\n"
"    var active=b.dataset.tab===name;\n"
"    b.setAttribute('aria-selected',active?'true':'false');\n"
"    if(active)b.classList.add('on');\n"
"    else b.classList.remove('on');\n"
"  });\n"
"  document.querySelectorAll('.tab-panel').forEach(function(p){\n"
"    if(p.id==='tab-'+name)p.classList.add('on');\n"
"    else p.classList.remove('on');\n"
"  });\n"
"}\n"
"\n"
"function initTabs(){\n"
"  document.querySelectorAll('.tab-btn').forEach(function(b){\n"
"    b.onclick=function(){showTab(b.dataset.tab);};\n"
"  });\n"
"}\n"
"\n"
"function apiRootFromLocation(){\n"
"  var p=window.location.pathname;\n"
"  var i=p.indexOf('/dashboard');\n"
"  if(i>=0)return p.slice(0,i);\n"
"  if(p.length>1&&p.charAt(p.length-1)==='/')p=p.slice(0,-1);\n"
"  i=p.lastIndexOf('/');\n"
"  return i>0?p.slice(0,i):'';\n"
"}\n"
"\n"
"function apiUrl(path){ return apiRoot+path; }\n"
"\n"
"function niceName(k){\n"
"  return String(k).replace(/[-_]/g,' ').replace(/^./,function(c){return c.toUpperCase();});\n"
"}\n"
"\n"
"function modLabel(name){ return modLabels[name]||niceName(name); }\n"
"\n"
"function friendlyName(pathDef,name){\n"
"  try{var t=pathDef.get.tags;if(t&&t.length&&t[0])return t[0];}catch(_){}\n"
"  return niceName(name);\n"
"}\n"
"\n"
"function fmtVal(v){\n"
"  if(v===null||v===undefined) return {t:'-',c:'pv-n'};\n"
"  if(typeof v==='boolean')    return {t:v?'true':'false',c:v?'pv-t':'pv-f'};\n"
"  return {t:String(v),c:''};\n"
"}\n"
"\n"
"function makeCard(name,path,label){\n"
"  var d=document.createElement('div');\n"
"  d.className='card';\n"
"  d.id='card-'+name;\n"
"  d.innerHTML=\n"
"    '<div class=\"card-head\">'+\n"
"      '<span class=\"card-name\"></span>'+\n"
"      '<span class=\"badge badge-load\" id=\"b-'+name+'\">Loading</span>'+\n"
"    '</div>'+\n"
"    '<div class=\"props\" id=\"p-'+name+'\"></div>'+\n"
"    '<div class=\"actions\" id=\"a-'+name+'\"></div>';\n"
"  d.querySelector('.card-name').textContent=label;\n"
"  cards[name]=path;\n"
"  return d;\n"
"}\n"
"\n"
"function fillActions(name){\n"
"  var wrap=document.getElementById('a-'+name);\n"
"  if(!wrap) return;\n"
"  wrap.innerHTML='';\n"
"  var list=actions[name]||[];\n"
"  if(!list.length){wrap.style.display='none';return;}\n"
"  wrap.style.display='flex';\n"
"  list.forEach(function(a){\n"
"    var btn=document.createElement('button');\n"
"    btn.type='button';\n"
"    btn.className='action-btn';\n"
"    btn.textContent=a.label;\n"
"    btn.dataset.label=a.label;\n"
"    if(a.desc)btn.title=a.desc;\n"
"    btn.addEventListener('click',function(){invokeAction(name,a.key,btn);});\n"
"    wrap.appendChild(btn);\n"
"  });\n"
"}\n"
"\n"
"function fillCard(name,data){\n"
"  var b=document.getElementById('b-'+name);\n"
"  var p=document.getElementById('p-'+name);\n"
"  var c=document.getElementById('card-'+name);\n"
"  if(!b||!p) return;\n"
"  b.className='badge badge-ok'; b.textContent='OK';\n"
"  p.innerHTML='';\n"
"  if(!data||typeof data!=='object'){\n"
"    p.innerHTML='<span class=\"card-empty\">No data</span>';\n"
"    return;\n"
"  }\n"
"  var keys=Object.keys(data);\n"
"  if(!keys.length){\n"
"    p.innerHTML='<span class=\"card-empty\">No properties</span>';\n"
"  }\n"
"  keys.forEach(function(k){\n"
"    var r=fmtVal(data[k]);\n"
"    var canEdit=writableProps[name]&&writableProps[name][k];\n"
"    var row=document.createElement('div');\n"
"    row.className='prop';\n"
"    var vspan=document.createElement('span');\n"
"    vspan.className='pv '+r.c+(canEdit?' editable':'');\n"
"    vspan.textContent=r.t;\n"
"    if(canEdit)(function(k2,vs){vs.addEventListener('click',function(){startEdit(vs,name,k2);});})(k,vspan);\n"
"    row.innerHTML='<span class=\"pk\">'+k+'</span>';\n"
"    row.appendChild(vspan);\n"
"    p.appendChild(row);\n"
"  });\n"
"  if(c){ c.classList.add('updated'); setTimeout(function(){ c.classList.remove('updated'); },600); }\n"
"}\n"
"\n"
"function errCard(name){\n"
"  var b=document.getElementById('b-'+name);\n"
"  if(b){ b.className='badge badge-err'; b.textContent='Error'; }\n"
"}\n"
"\n"
"function pumpRequestQueue(){\n"
"  if(requestBusy||!requestQueue.length)return;\n"
"  var item=requestQueue.shift();\n"
"  requestBusy=true;\n"
"  var p;\n"
"  try{p=item.task();}catch(e){requestBusy=false;item.reject(e);setTimeout(pumpRequestQueue,25);return;}\n"
"  p.then(item.resolve,item.reject).then(function(){\n"
"    requestBusy=false;setTimeout(pumpRequestQueue,25);\n"
"  },function(){\n"
"    requestBusy=false;setTimeout(pumpRequestQueue,25);\n"
"  });\n"
"}\n"
"\n"
"function queueRequest(task){\n"
"  return new Promise(function(resolve,reject){\n"
"    requestQueue.push({task:task,resolve:resolve,reject:reject});\n"
"    pumpRequestQueue();\n"
"  });\n"
"}\n"
"\n"
"function queueFetchCard(name){\n"
"  if(!cards[name]||queuedCards[name])return;\n"
"  queuedCards[name]=1;\n"
"  refreshTimers[name]=setTimeout(function(){\n"
"    delete refreshTimers[name];\n"
"    fetchCard(name).then(function(){delete queuedCards[name];},\n"
"      function(){delete queuedCards[name];});\n"
"  },CARD_REFRESH_DEBOUNCE_MS);\n"
"}\n"
"\n"
"function fetchCard(name){\n"
"  if(!cards[name])return Promise.resolve();\n"
"  return queueRequest(function(){\n"
"    return fetch(cards[name])\n"
"      .then(function(r){ return r.json(); })\n"
"      .then(function(d){ fillCard(name,d); })\n"
"      .catch(function(){ errCard(name); });\n"
"  });\n"
"}\n"
"\n"
"function postProp(name,key,raw){\n"
"  var val=raw;\n"
"  if(raw==='true')val=true;\n"
"  else if(raw==='false')val=false;\n"
"  else if(raw!==''&&!isNaN(raw))val=Number(raw);\n"
"  var body={};body[key]=val;\n"
"  return queueRequest(function(){\n"
"    return fetch(cards[name],{method:'POST',\n"
"      headers:{'Content-Type':'application/json'},body:JSON.stringify(body)})\n"
"      .then(function(r){ return r.text().then(function(){return r;},function(){return r;}); });\n"
"  });\n"
"}\n"
"\n"
"function actionDone(btn,ok){\n"
"  var label=btn.dataset.label;\n"
"  btn.classList.add(ok?'ok':'err');\n"
"  btn.textContent=ok?'Done':'Failed';\n"
"  setTimeout(function(){\n"
"    btn.classList.remove('ok','err');\n"
"    btn.textContent=label;\n"
"  },1200);\n"
"}\n"
"\n"
"function invokeAction(name,key,btn){\n"
"  if(btn.disabled) return;\n"
"  btn.disabled=true;\n"
"  btn.textContent='Running';\n"
"  postProp(name,key,'true')\n"
"    .then(function(r){\n"
"      btn.disabled=false;\n"
"      actionDone(btn,r.ok);\n"
"      if(r.ok) queueFetchCard(name);\n"
"    })\n"
"    .catch(function(){btn.disabled=false;actionDone(btn,false);});\n"
"}\n"
"\n"
"function startEdit(span,name,key){\n"
"  var enumVals=enums[name]&&enums[name][key];\n"
"  var inp;var saving=false;\n"
"  if(enumVals){\n"
"    inp=document.createElement('select');\n"
"    inp.className='prop-select';\n"
"    enumVals.forEach(function(v){\n"
"      var o=document.createElement('option');\n"
"      o.value=String(v);o.textContent=String(v);\n"
"      if(String(v)===span.textContent)o.selected=true;\n"
"      inp.appendChild(o);\n"
"    });\n"
"  } else {\n"
"    inp=document.createElement('input');\n"
"    inp.className='prop-input';\n"
"    inp.value=span.textContent==='-'?'':span.textContent;\n"
"  }\n"
"  span.parentNode.replaceChild(inp,span);\n"
"  inp.focus();if(!enumVals)inp.select();\n"
"  function restore(){if(inp.parentNode)inp.parentNode.replaceChild(span,inp);}\n"
"  function save(){\n"
"    saving=true;\n"
"    postProp(name,key,inp.value)\n"
"      .then(function(r){\n"
"        if(r.ok){restore();queueFetchCard(name);}\n"
"        else{restore();span.style.color='var(--red)';setTimeout(function(){span.style.color='';},1200);}\n"
"      })\n"
"      .catch(function(){restore();});\n"
"  }\n"
"  if(enumVals){\n"
"    inp.addEventListener('change',save);\n"
"    inp.addEventListener('keydown',function(e){if(e.key==='Escape')restore();});\n"
"    inp.addEventListener('blur',function(){if(!saving)restore();});\n"
"  } else {\n"
"    inp.addEventListener('keydown',function(e){\n"
"      if(e.key==='Enter')save();\n"
"      if(e.key==='Escape')restore();\n"
"    });\n"
"    inp.addEventListener('blur',function(){if(!saving)restore();});\n"
"  }\n"
"}\n"
"\n"
"function buildFilterUI(){\n"
"  var ef=document.getElementById('efilter');\n"
"  if(!allModEndpoints.length){ef.style.display='none';return;}\n"
"  ef.innerHTML='';\n"
"  var all=document.createElement('span');\n"
"  all.className='chip chip-all on';\n"
"  all.textContent='All';\n"
"  all.onclick=function(){\n"
"    filter={};\n"
"    ef.querySelectorAll('.chip').forEach(function(c){c.classList.add('on');});\n"
"    clearEventList('Connecting to event stream...');\n"
"    startSSE();\n"
"  };\n"
"  ef.appendChild(all);\n"
"  allModEndpoints.forEach(function(n,i){\n"
"    var c=document.createElement('span');\n"
"    c.className='chip on';\n"
"    c.dataset.mod=n;\n"
"    c.textContent=allModNames[i]||modLabel(n);\n"
"    c.onclick=function(){toggleFilter(n,c,all);};\n"
"    ef.appendChild(c);\n"
"  });\n"
"}\n"
"\n"
"function buildReplayUI(){\n"
"  var rf=document.getElementById('rfilter');\n"
"  var submit=document.getElementById('rsubmit');\n"
"  if(!allModEndpoints.length){rf.style.display='none';return;}\n"
"  rf.innerHTML='';\n"
"  var all=document.createElement('span');\n"
"  all.className='chip chip-all on';\n"
"  all.textContent='All';\n"
"  all.onclick=function(){\n"
"    replayFilter={};\n"
"    rf.querySelectorAll('.chip').forEach(function(c){c.classList.add('on');});\n"
"  };\n"
"  rf.appendChild(all);\n"
"  allModEndpoints.forEach(function(n,i){\n"
"    var c=document.createElement('span');\n"
"    c.className='chip on';\n"
"    c.dataset.mod=n;\n"
"    c.textContent=allModNames[i]||modLabel(n);\n"
"    c.onclick=function(){toggleReplayFilter(n,c,all);};\n"
"    rf.appendChild(c);\n"
"  });\n"
"  if(submit)submit.onclick=runReplay;\n"
"  buildReplaySeverityUI();\n"
"}\n"
"\n"
"function buildReplaySeverityUI(){\n"
"  var sf=document.getElementById('rseverity');\n"
"  if(!sf)return;\n"
"  sf.innerHTML='';\n"
"  var all=document.createElement('span');\n"
"  all.className='chip chip-all on';\n"
"  all.textContent='All severities';\n"
"  all.onclick=function(){\n"
"    replaySeverityFilter={};\n"
"    sf.querySelectorAll('.chip').forEach(function(c){c.classList.add('on');});\n"
"  };\n"
"  sf.appendChild(all);\n"
"  severityNames.forEach(function(n){\n"
"    var c=document.createElement('span');\n"
"    c.className='chip on';\n"
"    c.dataset.severity=n;\n"
"    c.textContent=niceName(n);\n"
"    c.onclick=function(){toggleReplaySeverity(n,c,all);};\n"
"    sf.appendChild(c);\n"
"  });\n"
"}\n"
"\n"
"function toggleReplaySeverity(name,chip,allChip){\n"
"  if(replaySeverityFilter[name]){delete replaySeverityFilter[name];chip.classList.add('on');}\n"
"  else{replaySeverityFilter[name]=1;chip.classList.remove('on');}\n"
"  if(Object.keys(replaySeverityFilter).length)allChip.classList.remove('on');\n"
"  else allChip.classList.add('on');\n"
"}\n"
"\n"
"function toggleReplayFilter(name,chip,allChip){\n"
"  if(replayFilter[name]){delete replayFilter[name];chip.classList.add('on');}\n"
"  else{replayFilter[name]=1;chip.classList.remove('on');}\n"
"  if(Object.keys(replayFilter).length)allChip.classList.remove('on');\n"
"  else allChip.classList.add('on');\n"
"}\n"
"\n"
"function toggleFilter(name,chip,allChip){\n"
"  if(filter[name]){delete filter[name];chip.classList.add('on');}\n"
"  else{filter[name]=1;chip.classList.remove('on');}\n"
"  if(Object.keys(filter).length)allChip.classList.remove('on');\n"
"  else allChip.classList.add('on');\n"
"  clearEventList('Connecting to event stream...');\n"
"  startSSE();\n"
"}\n"
"\n"
"function clearEventList(message){\n"
"  var list=document.getElementById('elist');\n"
"  var meta=document.getElementById('emeta');\n"
"  if(!list)return;\n"
"  evCount=0;\n"
"  list.innerHTML='';\n"
"  var emp=document.createElement('div');\n"
"  emp.className='empty-feed';\n"
"  emp.textContent=message||'Waiting for events...';\n"
"  list.appendChild(emp);\n"
"  if(meta)meta.textContent='waiting...';\n"
"}\n"
"\n"
"function clearReplayList(message){\n"
"  var list=document.getElementById('rlist');\n"
"  var meta=document.getElementById('rmeta');\n"
"  if(!list)return;\n"
"  replayCount=0;\n"
"  list.innerHTML='';\n"
"  var emp=document.createElement('div');\n"
"  emp.className='empty-feed';\n"
"  emp.textContent=message||'Replay results will appear here.';\n"
"  list.appendChild(emp);\n"
"  if(meta)meta.textContent='idle';\n"
"}\n"
"\n"
"function applyFilter(){\n"
"  document.getElementById('elist').querySelectorAll('.ev').forEach(function(el){\n"
"    el.style.display=filter[el.dataset.mod]?'none':'';\n"
"  });\n"
"}\n"
"\n"
"function makeEventItem(mod,d,sec){\n"
"  var item=document.createElement('div');\n"
"  item.className='ev';\n"
"  var ep=modNames[mod];\n"
"  var src=ep?modLabel(ep):('mod '+mod);\n"
"  var kvHtml='';\n"
"  if(d&&typeof d==='object'){\n"
"    kvHtml='<div class=\"ev-kv\">';\n"
"    Object.keys(d).forEach(function(k){\n"
"      kvHtml+='<span class=\"ev-pair\"><span class=\"ev-key\">'+k+'</span>'+\n"
"               '<span class=\"ev-val\">'+String(d[k])+'</span></span>';\n"
"    });\n"
"    kvHtml+='</div>';\n"
"  } else if(d){\n"
"    kvHtml='<span>'+String(d)+'</span>';\n"
"  }\n"
"  item.innerHTML=\n"
"    '<span class=\"ev-time\">'+ts(sec)+'</span>'+\n"
"    '<span class=\"ev-src\">'+src+'</span>'+\n"
"    '<div class=\"ev-body\">'+kvHtml+'</div>';\n"
"  item.dataset.mod=ep||src;\n"
"  return item;\n"
"}\n"
"\n"
"function addEvent(mod,d,sec){\n"
"  evCount++;\n"
"  var list=document.getElementById('elist');\n"
"  var emp=list.querySelector('.empty-feed');\n"
"  if(emp) list.removeChild(emp);\n"
"  var ep=modNames[mod];\n"
"  var item=makeEventItem(mod,d,sec);\n"
"  list.insertBefore(item,list.firstChild);\n"
"  while(list.children.length>60) list.removeChild(list.lastChild);\n"
"  applyFilter();\n"
"  document.getElementById('emeta').textContent=evCount+' received';\n"
"  if(ep) queueFetchCard(ep);\n"
"}\n"
"\n"
"function addReplayEvent(mod,d,sec){\n"
"  replayCount++;\n"
"  var list=document.getElementById('rlist');\n"
"  var emp=list.querySelector('.empty-feed');\n"
"  if(emp) list.removeChild(emp);\n"
"  var item=makeEventItem(mod,d,sec);\n"
"  list.insertBefore(item,list.firstChild);\n"
"  while(list.children.length>100) list.removeChild(list.lastChild);\n"
"  document.getElementById('rmeta').textContent=replayCount+' replayed';\n"
"}\n"
"\n"
"function selectedMods(){\n"
"  return allModEndpoints.filter(function(n){return !filter[n];});\n"
"}\n"
"\n"
"function selectedReplayMods(){\n"
"  return allModEndpoints.filter(function(n){return !replayFilter[n];});\n"
"}\n"
"\n"
"function selectedReplaySeverities(){\n"
"  return severityNames.filter(function(n){return !replaySeverityFilter[n];});\n"
"}\n"
"\n"
"function eventStreamUrl(){\n"
"  var mods=selectedMods();\n"
"  if(!allModEndpoints.length||mods.length===allModEndpoints.length)return apiUrl('/events');\n"
"  if(!mods.length)return '';\n"
"  return apiUrl('/events?modules='+mods.map(encodeURIComponent).join(','));\n"
"}\n"
"\n"
"function replayUrl(){\n"
"  var mods=selectedReplayMods();\n"
"  var severities=selectedReplaySeverities();\n"
"  var limit=document.getElementById('rlimit');\n"
"  var n=limit?parseInt(limit.value,10):20;\n"
"  if(isNaN(n)||n<0)n=20;\n"
"  if(n>100)n=100;\n"
"  var q=['limit='+encodeURIComponent(n)];\n"
"  if(allModEndpoints.length&&mods.length&&mods.length<allModEndpoints.length){\n"
"    q.push('modules='+mods.map(encodeURIComponent).join(','));\n"
"  }\n"
"  if(severities.length&&severities.length<severityNames.length){\n"
"    q.push('severity='+severities.map(encodeURIComponent).join(','));\n"
"  }\n"
"  return apiUrl('/events/replay?'+q.join('&'));\n"
"}\n"
"\n"
"function runReplay(){\n"
"  var mods=selectedReplayMods();\n"
"  var severities=selectedReplaySeverities();\n"
"  var btn=document.getElementById('rsubmit');\n"
"  if(allModEndpoints.length&&!mods.length){clearReplayList('No replay modules selected.');return;}\n"
"  if(!severities.length){clearReplayList('No severities selected.');return;}\n"
"  clearReplayList('Loading replay...');\n"
"  if(btn){btn.disabled=true;btn.textContent='Loading';}\n"
"  fetch(replayUrl())\n"
"    .then(function(r){if(!r.ok)throw new Error('HTTP '+r.status);return r.json();})\n"
"    .then(function(events){\n"
"      clearReplayList(events&&events.length?'':'No replayed events.');\n"
"      (events||[]).forEach(function(e){addReplayEvent(e.module,e.d,e.ts);});\n"
"    })\n"
"    .catch(function(e){clearReplayList('Replay failed: '+e.message);})\n"
"    .then(function(){if(btn){btn.disabled=false;btn.textContent='Replay';}});\n"
"}\n"
"\n"
"function setLive(ok,label){\n"
"  var dot=document.getElementById('dot');\n"
"  var lbl=document.getElementById('liveLabel');\n"
"  if(ok){ dot.className='dot ok'; lbl.textContent=label||'Live'; }\n"
"  else  { dot.className='dot';    lbl.textContent=label||'Reconnecting'; }\n"
"}\n"
"\n"
"function startSSE(){\n"
"  if(eventSource){eventSource.close();eventSource=null;}\n"
"  var url=eventStreamUrl();\n"
"  if(!url){clearEventList('Event stream paused');setLive(false,'Paused');return;}\n"
"  setLive(false,'Connecting');\n"
"  var es=new EventSource(url);\n"
"  eventSource=es;\n"
"  es.onopen=function(){ if(eventSource===es)setLive(true); };\n"
"  es.onmessage=function(e){\n"
"    if(eventSource!==es)return;\n"
"    try{ var d=JSON.parse(e.data); addEvent(d.module,d.d,d.ts); }catch(_){}\n"
"  };\n"
"  es.onerror=function(){ if(eventSource===es)setLive(false); };\n"
"}\n"
"\n"
"function init(){\n"
"  initTabs();\n"
"  fetch(apiUrl('/openapi.json'))\n"
"    .then(function(r){ return r.json(); })\n"
"    .then(function(api){\n"
"      var grid=document.getElementById('grid');\n"
"      Object.keys(api.paths||{}).forEach(function(p){\n"
"        var n=epName(p);\n"
"        if(SKIP[n]||p.indexOf('/events')>=0||!api.paths[p].get) return;\n"
"        var label=friendlyName(api.paths[p],n);\n"
"        modLabels[n]=label;\n"
"        var moduleId=api.paths[p].get['x-module-id'];\n"
"        if(typeof moduleId==='number'&&moduleId>=0)modNames[moduleId]=n;\n"
"        allModEndpoints.push(n);\n"
"        allModNames.push(label);\n"
"        writableProps[n]={};\n"
"        actions[n]=[];\n"
"        var sc=null;\n"
"        try{sc=api.paths[p].get.responses['200'].content['application/json'].schema;}catch(_){}\n"
"        if(sc&&sc.properties){enums[n]={};\n"
"          Object.keys(sc.properties).forEach(function(pk){\n"
"            if(sc.properties[pk]['enum'])enums[n][pk]=sc.properties[pk]['enum'];\n"
"            else if(sc.properties[pk]['type']==='boolean')enums[n][pk]=['true','false'];\n"
"          });\n"
"        }\n"
"        var ps=null;\n"
"        try{ps=api.paths[p].post.requestBody.content['application/json'].schema.properties;}catch(_){}\n"
"        if(ps){\n"
"          Object.keys(ps).forEach(function(pk){\n"
"            var prop=ps[pk]||{};\n"
"            if(prop.writeOnly){\n"
"              actions[n].push({key:pk,label:niceName(pk),desc:prop.description||''});\n"
"            } else {\n"
"              writableProps[n][pk]=1;\n"
"              if(!enums[n])enums[n]={};\n"
"              if(prop['enum'])enums[n][pk]=prop['enum'];\n"
"              else if(prop['type']==='boolean')enums[n][pk]=['true','false'];\n"
"            }\n"
"          });\n"
"        }\n"
"        if(!Object.keys(actions[n]).length)delete actions[n];\n"
"        if(!Object.keys(writableProps[n]).length)delete writableProps[n];\n"
"        grid.appendChild(makeCard(n,p,label));\n"
"        fillActions(n);\n"
"      });\n"
"      buildFilterUI();\n"
"      buildReplayUI();\n"
"      startSSE();\n"
"      Object.keys(cards).forEach(queueFetchCard);\n"
"      setInterval(function(){ Object.keys(cards).forEach(queueFetchCard); },30000);\n"
"    })\n"
"    .catch(function(e){\n"
"      document.getElementById('grid').innerHTML=\n"
"        '<div style=\"color:var(--red);font-size:13px\">Failed to load device API: '+e+'</div>';\n"
"    });\n"
"}\n"
"\n"
"window.onload=init;\n"
"</script>\n"
"</body>\n"
"</html>\n";
