## zephyr/Kconfig
```kconfig
menu "Qoraal-http"

config QORAAL_HTTP
    bool "Enable Qoraal framework"
    default n
    # The http client sets SO_SNDTIMEO, so a send cannot block for as long
    # as the server does not read; without this Zephyr refuses the option.
    imply NET_CONTEXT_SNDTIMEO

if QORAAL_HTTP

config QORAAL_HTTP_SERVER_TLS
    bool "Enable http server"
    select MBEDTLS
    default y

config QORAAL_HTTP_CLIENT_TLS
    bool "Enable http client"
    select MBEDTLS
    default y

config QORAAL_HTTP_SERVER_USER_THREAD
    int "HTTP server user thread count"
    default 2
    help
      Maximum number of HTTP request worker threads.

config QORAAL_HTTP_SERVER_USER_THREAD_SIZE
    int "HTTP server user thread stack size"
    default 4032
    help
      Stack size, in bytes, for each HTTP request worker thread.

config QORAAL_HTTP_SERVER_CONTENT_MAX
    int "HTTP server largest request body read into memory"
    default 16384
    help
      Largest request body httpserver_read_all_content_ex() reads into
      memory; a larger one is refused before anything is allocated. Bodies
      read in pieces, such as file uploads, are not limited. Raise it for a
      handler that reads a whole file this way.

config QORAAL_HTTP_SERVER_TLS_SESSION_CACHE_ENTRIES
    int "HTTP server TLS session cache entries"
    default 16
    depends on QORAAL_HTTP_SERVER_TLS
    help
      Number of recently negotiated TLS sessions to keep for session-ID
      resumption. This is sized for clients/recent browser sockets, not one
      entry per worker thread.

endif # QORAAL_HTTP

endmenu
```
